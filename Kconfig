## Kconfig
```kconfig
# Copyright (c) 2024 The ZMK Contributors
# SPDX-License-Identifier: MIT

rsource "boards/shields/*/Kconfig.shield"
rsource "boards/shields/*/Kconfig.defconfig"
```

## boards/shields/bgg2/Kconfig.shield
```kconfig
# Copyright (c) 2023 The ZMK Contributors
# SPDX-License-Identifier: MIT

config SHIELD_BGG2_LEFT
    def_bool $(shields_list_contains,bgg2_left)

config SHIELD_BGG2_RIGHT
    def_bool $(shields_list_contains,bgg2_right)

config SHIELD_BGG2_DONGLE
  def_bool $(shields_list_contains,bgg2_dongle)
```
